## rts/seL4/Kconfig
```kconfig
config LIBSEL4_IDRIS_RTS
    bool "libsel4-idris-rts"
    default y
    depends on (LIB_MUSL_C || LIB_SEL4_C)
    select HAVE_LIBSEL4_IDRIS_RTS
    help
        Idris RTS compiled for seL4

config HAVE_LIBSEL4_IDRIS_RTS
    bool
```
